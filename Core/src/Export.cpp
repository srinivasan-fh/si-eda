#include "sieda/Export.hpp"

#include <algorithm>
#include <cctype>
#include <cmath>
#include <cstdio>
#include <map>
#include <set>
#include <sstream>
#include <tuple>
#include <vector>

#include "sieda/Bom.hpp"
#include "sieda/Simulator.hpp"
#include "sieda/Units.hpp"

namespace sieda {

namespace {
std::string spiceNode(const Schematic& sch, PinRef pin) {
    int n = sch.netOf(pin);
    if (n < 0) return "NC_" + std::to_string(pin.component) + "_" + std::to_string(pin.pin);
    const Net& net = sch.nets()[static_cast<size_t>(n)];
    if (net.isGround) return "0";
    std::string s = net.name;
    for (char& c : s)
        if (!std::isalnum(static_cast<unsigned char>(c)) && c != '_') c = '_';
    return s;
}

std::string spiceSource(const std::string& value) {
    auto spec = SourceSpec::parse(value);
    if (!spec) return "DC 0";
    char buf[160];
    switch (spec->kind) {
        case SourceSpec::Kind::DC: std::snprintf(buf, sizeof buf, "DC %g", spec->dc); break;
        case SourceSpec::Kind::Sine:
            std::snprintf(buf, sizeof buf, "SIN(%g %g %g)", spec->offset, spec->amplitude, spec->frequency);
            break;
        case SourceSpec::Kind::Pulse:
            std::snprintf(buf, sizeof buf, "PULSE(%g %g 0 1n 1n %g %g)", spec->v1, spec->v2, spec->period * spec->duty,
                          spec->period);
            break;
    }
    return buf;
}

std::string mm(double v) {
    char b[32];
    std::snprintf(b, sizeof b, "%.4f", v);
    return b;
}

std::string footprintLabel(const Component& c) {
    const FootprintDef* fp = Library::instance().footprint(c.footprintName());
    if (!fp) return c.footprintName();
    return fp->label.empty() ? fp->name : fp->label;
}

std::string csvEscape(const std::string& s) {
    if (s.find_first_of(",\"\n") == std::string::npos) return s;
    std::string out = "\"";
    for (char c : s) out += c == '"' ? std::string("\"\"") : std::string(1, c);
    return out + "\"";
}
}  // namespace

std::string exportSpiceNetlist(const Schematic& sch, const std::string& title) {
    std::ostringstream o;
    o << "* " << (title.empty() ? "SiEDA design" : title) << "\n* Generated by SiEDA\n";
    std::set<std::string> models;
    for (const auto& c : sch.components()) {
        auto n = [&](int pin) { return spiceNode(sch, {c.id, pin}); };
        switch (c.kind) {
            case ComponentKind::Resistor: o << c.ref << " " << n(0) << " " << n(1) << " " << primaryValue(c.value) << "\n"; break;
            case ComponentKind::Capacitor: o << c.ref << " " << n(0) << " " << n(1) << " " << primaryValue(c.value) << "\n"; break;
            case ComponentKind::Inductor: o << c.ref << " " << n(0) << " " << n(1) << " " << primaryValue(c.value) << "\n"; break;
            case ComponentKind::Fuse: o << "R" << c.ref << " " << n(0) << " " << n(1) << " 0.05 ; fuse " << c.value << "\n"; break;
            case ComponentKind::Switch: {
                bool on = c.value == "on" || c.value == "closed" || c.value == "1";
                o << "R" << c.ref << " " << n(0) << " " << n(1) << " " << (on ? "0.01" : "1G") << " ; switch\n";
                break;
            }
            case ComponentKind::VoltageSource:
            case ComponentKind::Battery:
            case ComponentKind::ACSource:  // SPICE voltage sources are named V…: BT1 → VBT1
                o << (c.ref.empty() || (c.ref[0] != 'V' && c.ref[0] != 'v') ? "V" : "") << c.ref << " " << n(0) << " "
                  << n(1) << " " << spiceSource(c.value) << "\n";
                break;
            case ComponentKind::CurrentSource:
                // SPICE current flows from n+ through the source to n-; ours leaves "+", so swap nodes.
                o << c.ref << " " << n(1) << " " << n(0) << " " << spiceSource(c.value) << "\n";
                break;
            case ComponentKind::Diode:
                o << c.ref << " " << n(0) << " " << n(1) << " DSIEDA\n";
                models.insert(".model DSIEDA D(Is=2.52n N=1.752)");
                break;
            case ComponentKind::LED:
                o << c.ref << " " << n(0) << " " << n(1) << " DLED\n";
                models.insert(".model DLED D(Is=1e-18 N=2)");
                break;
            case ComponentKind::NPN:
                o << c.ref << " " << n(1) << " " << n(0) << " " << n(2) << " QSIEDA\n";
                models.insert(".model QSIEDA NPN(Is=1e-14 Bf=200 Br=1)");
                break;
            case ComponentKind::NMOS:
                o << c.ref << " " << n(1) << " " << n(0) << " " << n(2) << " " << n(2) << " MSIEDA\n";
                models.insert(".model MSIEDA NMOS(Vto=1.6 Kp=0.1 Lambda=0.01)");
                break;
            case ComponentKind::OpAmp:
                o << "X" << c.ref << " " << n(0) << " " << n(1) << " " << n(2) << " OPAMP_IDEAL\n";
                models.insert(".subckt OPAMP_IDEAL inp inn out\nE1 out 0 inp inn 1e6\n.ends");
                break;
            case ComponentKind::Connector:
            case ComponentKind::IC8:
            case ComponentKind::Custom:
                o << "* " << c.ref << " (" << c.def().name << ", " << c.value << ") has no SPICE model\n";
                break;
            default: break;
        }
    }
    for (const auto& m : models) o << m << "\n";
    o << ".op\n.end\n";
    return o.str();
}

std::string exportBomCsv(const Schematic& sch) {
    std::ostringstream o;
    o << "Item,Quantity,References,Type,Value,Footprint,Description,Rating,Manufacturer,MPN,Supplier Part,"
         "Unit Price,Line Total,DNP\n";
    for (const auto& l : buildBom(sch)) {
        std::string refs;
        for (size_t i = 0; i < l.refs.size(); ++i) refs += (i ? " " : "") + l.refs[i];
        auto money = [](double v) { return v > 0 ? mm(v) : std::string(); };
        o << l.item << "," << l.quantity() << "," << csvEscape(refs) << "," << csvEscape(l.type) << "," << csvEscape(l.value)
          << "," << csvEscape(l.footprint) << "," << csvEscape(l.description) << "," << csvEscape(l.rating) << ","
          << csvEscape(l.sourcing.manufacturer) << "," << csvEscape(l.sourcing.mpn) << "," << csvEscape(l.sourcing.supplierPart)
          << "," << money(l.sourcing.unitPrice) << "," << money(l.lineCost()) << "," << (l.sourcing.dnp ? "DNP" : "") << "\n";
    }
    return o.str();
}

std::string exportPickAndPlaceCsv(const Schematic& sch) {
    std::ostringstream o;
    o << "Designator,Value,Footprint,Mid X (mm),Mid Y (mm),Rotation,Layer\n";
    for (const auto& c : sch.components()) {
        if (!c.hasFootprint() || !c.pcb.placed || c.pcb.embedded()) continue;  // embedded parts are not assembled
        o << c.ref << "," << csvEscape(c.value) << "," << csvEscape(footprintLabel(c)) << "," << mm(c.pcb.position.x) << ","
          << mm(c.pcb.position.y) << "," << c.pcb.rotation << "," << (c.pcb.bottom ? "Bottom" : "Top") << "\n";
    }
    return o.str();
}

static std::string exportGerberImpl(const Schematic& sch, const PcbLayout& pcb, GerberLayer layer, int copperIndex);

std::string exportGerber(const Schematic& sch, const PcbLayout& pcb, GerberLayer layer) {
    return exportGerberImpl(sch, pcb, layer, -1);
}

std::string exportCopperGerber(const Schematic& sch, const PcbLayout& pcb, int copperLayer) {
    return exportGerberImpl(sch, pcb, GerberLayer::TopCopper, copperLayer);
}

static std::string exportGerberImpl(const Schematic& sch, const PcbLayout& pcb, GerberLayer layer, int copperIndex) {
    const auto& s = pcb.settings;
    auto coord = [&](Vec2 p) {
        long long x = std::llround(p.x * 1e6), y = std::llround((s.height - p.y) * 1e6);
        return "X" + std::to_string(x) + "Y" + std::to_string(y);
    };
    std::ostringstream o;
    const char* names[] = {"Copper,L1,Top", "Copper,L2,Bot", "Soldermask,Top", "Soldermask,Bot", "Legend,Top",
                           "Profile,NP",    "Paste,Top",     "Paste,Bot",      "Legend,Bot"};
    o << "G04 SiEDA Gerber RS-274X*\n";
    o << "%TF.GenerationSoftware,SiEDA,SiEDA,1.0*%\n";
    const int bottom = pcb.settings.bottomLayer();
    if (copperIndex >= 0) {
        std::string side = copperIndex == 0 ? "Top" : (copperIndex == bottom ? "Bot" : "Inr");
        o << "%TF.FileFunction,Copper,L" << (copperIndex + 1) << "," << side << "*%\n";
    } else if (layer == GerberLayer::BottomCopper) {
        o << "%TF.FileFunction,Copper,L" << (bottom + 1) << ",Bot*%\n";
    } else {
        o << "%TF.FileFunction," << names[static_cast<int>(layer)] << "*%\n";
    }
    // Solder mask images are the openings (negative polarity in Gerber X2); everything else is positive.
    bool maskFile = layer == GerberLayer::TopMask || layer == GerberLayer::BottomMask;
    o << "%TF.FilePolarity," << (maskFile && copperIndex < 0 ? "Negative" : "Positive") << "*%\n";
    o << "%TF.SameCoordinates,Original*%\n";
    o << "%FSLAX46Y46*%\n%MOMM*%\n%LPD*%\n";

    std::map<std::string, int> apertures;
    std::ostringstream body;
    int nextAperture = 10;
    auto aperture = [&](const std::string& def) {
        auto it = apertures.find(def);
        if (it != apertures.end()) return it->second;
        apertures[def] = nextAperture;
        return nextAperture++;
    };
    auto circle = [&](double d) { return "C," + mm(d); };
    auto rect = [&](double w, double h) { return "R," + mm(w) + "X" + mm(h); };

    std::vector<std::pair<int, std::string>> ops;  // aperture, operation
    std::vector<std::string> regions;              // filled G36/G37 regions (drawn first)
    bool isCopper = layer == GerberLayer::TopCopper || layer == GerberLayer::BottomCopper;
    bool isMask = layer == GerberLayer::TopMask || layer == GerberLayer::BottomMask;
    int cl = copperIndex >= 0 ? copperIndex
             : ((layer == GerberLayer::TopCopper || layer == GerberLayer::TopMask) ? kTopLayer : bottom);
    if (copperIndex >= 0) isCopper = true;

    if (isCopper || isMask) {
        double grow = isMask ? 0.05 : 0.0;
        for (const auto& p : pcb.pads(sch)) {
            if (!p.onLayer(cl)) continue;
            int ap = aperture(p.round ? circle(p.size.x + 2 * grow) : rect(p.size.x + 2 * grow, p.size.y + 2 * grow));
            ops.push_back({ap, coord(p.position) + "D03*"});
        }
        for (const auto& v : pcb.vias) {
            if (isMask || !v.spans(cl)) continue;  // tented vias; a via lands on the copper layers it spans
            ops.push_back({aperture(circle(v.diameter)), coord(v.position) + "D03*"});
        }
        if (isCopper) {
            // Poured copper as G36/G37 regions (one per merged rectangle).
            for (const auto& f : pcb.zoneFills(sch)) {
                if (f.layer != cl) continue;
                for (const auto& r : f.rects)
                    regions.push_back("G36*\n" + coord({r.x0, r.y0}) + "D02*\n" + coord({r.x1, r.y0}) + "D01*\n" +
                                      coord({r.x1, r.y1}) + "D01*\n" + coord({r.x0, r.y1}) + "D01*\n" +
                                      coord({r.x0, r.y0}) + "D01*\nG37*");
            }
            for (const auto& t : pcb.tracks) {
                if (t.layer != cl) continue;
                int ap = aperture(circle(t.width));
                ops.push_back({ap, coord(t.a) + "D02*\n" + coord(t.b) + "D01*"});
            }
        }
    } else if (layer == GerberLayer::TopPaste || layer == GerberLayer::BottomPaste) {
        // Stencil apertures: SMD pads of this side 1:1; large thermal / exposed pads at 80 % per side (≈ 64 % paste
        // area) so the part does not float on too much solder.
        int side = layer == GerberLayer::TopPaste ? kTopLayer : bottom;
        for (const auto& p : pcb.pads(sch)) {
            if (p.throughHole || p.smdLayer != side) continue;
            double w = p.size.x, h = p.size.y;
            if (w >= 2.5 && h >= 2.5) w *= 0.8, h *= 0.8;
            ops.push_back({aperture(p.round ? circle(w) : rect(w, h)), coord(p.position) + "D03*"});
        }
    } else if (layer == GerberLayer::TopSilk || layer == GerberLayer::BottomSilk) {
        const bool bottomSide = layer == GerberLayer::BottomSilk;
        int ap = aperture(circle(0.15));
        for (const auto& c : sch.components()) {
            if (!c.hasFootprint() || !c.pcb.placed || c.pcb.bottom != bottomSide || c.pcb.embedded()) continue;
            Rect r = pcb.courtyard(c).inflated(-0.15);
            ops.push_back({ap, coord({r.x0, r.y0}) + "D02*\n" + coord({r.x1, r.y0}) + "D01*\n" + coord({r.x1, r.y1}) +
                                   "D01*\n" + coord({r.x0, r.y1}) + "D01*\n" + coord({r.x0, r.y0}) + "D01*"});
            // Pin-1 marker dot.
            const FootprintDef* fp = Library::instance().footprint(c.footprintName());
            if (fp && !fp->pads.empty()) {
                Vec2 p1 = c.pcb.position + rotate90(fp->pads[0].offset, c.pcb.rotation);
                Vec2 dir = p1 - c.pcb.position;
                double len = dir.length();
                Vec2 mark = len > 1e-9 ? p1 + dir * (0.9 / len) : p1;
                ops.push_back({aperture(circle(0.3)), coord(mark) + "D03*"});
            }
            // Reference designator above the part (below it when that would leave the board).
            const double textH = 1.0;
            double width = silkscreenTextWidth(c.ref, textH);
            double baseline = r.y0 - 0.45;
            if (baseline - textH < s.edgeClearance) baseline = r.y1 + 0.45 + textH;
            Vec2 origin{(r.x0 + r.x1) / 2 + (bottomSide ? width / 2 : -width / 2), baseline};
            for (const auto& stroke : silkscreenText(c.ref, origin, textH, bottomSide)) {
                std::string path = coord(stroke[0]) + "D02*";
                for (size_t i = 1; i < stroke.size(); ++i) path += "\n" + coord(stroke[i]) + "D01*";
                ops.push_back({ap, path});
            }
        }
    } else {  // EdgeCuts: the outline polygon
        int ap = aperture(circle(0.1));
        auto poly = s.outlinePolygon();
        std::string path = coord(poly[0]) + "D02*";
        for (size_t i = 1; i <= poly.size(); ++i) path += "\n" + coord(poly[i % poly.size()]) + "D01*";
        ops.push_back({ap, path});
    }

    // Aperture definitions sorted by D-code.
    std::map<int, std::string> byCode;
    for (const auto& [def, code] : apertures) byCode[code] = def;
    for (const auto& [code, def] : byCode) {
        std::string type = def.substr(0, 1), params = def.substr(2);
        o << "%ADD" << code << type << "," << params << "*%\n";
    }
    if (!regions.empty()) o << "G01*\n";
    for (const auto& r : regions) o << r << "\n";
    int current = -1;
    for (const auto& [ap, op] : ops) {
        if (ap != current) {
            o << "D" << ap << "*\n";
            current = ap;
        }
        o << op << "\n";
    }
    o << "M02*\n";
    return o.str();
}

std::vector<std::pair<int, int>> viaSpans(const PcbLayout& pcb) {
    std::vector<std::pair<int, int>> spans;
    for (const auto& v : pcb.vias) {
        if (v.isThrough()) continue;
        std::pair<int, int> sp{v.fromLayer, v.lastLayer(pcb.settings.layerCount)};
        if (std::find(spans.begin(), spans.end(), sp) == spans.end()) spans.push_back(sp);
    }
    std::sort(spans.begin(), spans.end());
    return spans;
}

std::string exportExcellonSpan(const PcbLayout& pcb, int fromLayer, int toLayer) {
    const int n = pcb.settings.layerCount;
    std::map<std::string, std::vector<Vec2>> holes;
    std::string kind = "Buried";
    for (const auto& v : pcb.vias) {
        if (v.isThrough() || v.fromLayer != fromLayer || v.lastLayer(n) != toLayer) continue;
        char b[16];
        std::snprintf(b, sizeof b, "%.3f", v.drill);
        holes[b].push_back(v.position);
        if (fromLayer == 0 || toLayer == n - 1) kind = "Blind";
    }
    const bool laser = toLayer - fromLayer == 1;
    std::ostringstream o;
    o << "M48\n; SiEDA Excellon drill file — " << (laser ? "laser microvias" : kind == "Blind" ? "blind vias" : "buried vias")
      << " L" << fromLayer + 1 << "–L" << toLayer + 1 << " (" << copperLayerName(fromLayer, n) << " to "
      << copperLayerName(toLayer, n) << ")\n"
      << "; #@! TF.FileFunction,Plated," << fromLayer + 1 << "," << toLayer + 1 << "," << kind << "\n"
      << "; #@! TF.FilePolarity,Positive\nFMAT,2\nMETRIC,TZ\n";
    int tool = 1;
    for (const auto& [d, _] : holes) o << "T" << tool++ << "C" << d << "\n";
    o << "%\nG90\nG05\n";
    tool = 1;
    for (const auto& [d, pts] : holes) {
        o << "T" << tool++ << "\n";
        for (const auto& p : pts) o << "X" << mm(p.x) << "Y" << mm(pcb.settings.height - p.y) << "\n";
    }
    o << "T0\nM30\n";
    return o.str();
}

std::string exportExcellonDrill(const Schematic& sch, const PcbLayout& pcb, bool plated) {
    std::map<std::string, std::vector<Vec2>> holes;  // diameter → positions
    auto key = [](double d) {
        char b[16];
        std::snprintf(b, sizeof b, "%.3f", d);
        return std::string(b);
    };
    if (plated) {
        for (const auto& p : pcb.pads(sch))
            if (p.throughHole && p.drill > 0) holes[key(p.drill)].push_back(p.position);
        for (const auto& v : pcb.vias)
            if (v.isThrough()) holes[key(v.drill)].push_back(v.position);  // blind / buried: exportExcellonSpan
    } else {
        for (const auto& h : pcb.settings.holes) holes[key(h.drill)].push_back(h.position);
    }

    std::ostringstream o;
    o << "M48\n; SiEDA Excellon drill file (" << (plated ? "plated" : "non-plated") << ")\n"
      << "; #@! TF.FileFunction," << (plated ? "Plated,1," : "NonPlated,1,") << pcb.settings.layerCount
      << (plated ? ",PTH" : ",NPTH") << "\nFMAT,2\nMETRIC,TZ\n";
    int tool = 1;
    for (const auto& [d, _] : holes) o << "T" << tool++ << "C" << d << "\n";
    o << "%\nG90\nG05\n";
    tool = 1;
    for (const auto& [d, pts] : holes) {
        o << "T" << tool++ << "\n";
        for (const auto& p : pts) o << "X" << mm(p.x) << "Y" << mm(pcb.settings.height - p.y) << "\n";
    }
    o << "T0\nM30\n";
    return o.str();
}

namespace {
// Simple stroke font on a 4 × 6 grid (y up), one polyline per '|'-separated stroke: legible on silkscreen at 1 mm.
const std::map<char, const char*>& strokeFont() {
    static const std::map<char, const char*> font = {
        {'A', "0,0 0,4 2,6 4,4 4,0|0,3 4,3"},
        {'B', "0,0 0,6 3,6 4,5 4,4 3,3 0,3|3,3 4,2 4,1 3,0 0,0"},
        {'C', "4,1 3,0 1,0 0,1 0,5 1,6 3,6 4,5"},
        {'D', "0,0 0,6 3,6 4,5 4,1 3,0 0,0"},
        {'E', "4,0 0,0 0,6 4,6|0,3 3,3"},
        {'F', "0,0 0,6 4,6|0,3 3,3"},
        {'G', "4,5 3,6 1,6 0,5 0,1 1,0 3,0 4,1 4,3 2,3"},
        {'H', "0,0 0,6|4,0 4,6|0,3 4,3"},
        {'I', "1,0 3,0|2,0 2,6|1,6 3,6"},
        {'J', "0,1 1,0 3,0 4,1 4,6"},
        {'K', "0,0 0,6|4,6 0,2|1,3 4,0"},
        {'L', "0,6 0,0 4,0"},
        {'M', "0,0 0,6 2,3 4,6 4,0"},
        {'N', "0,0 0,6 4,0 4,6"},
        {'O', "1,0 0,1 0,5 1,6 3,6 4,5 4,1 3,0 1,0"},
        {'P', "0,0 0,6 3,6 4,5 4,4 3,3 0,3"},
        {'Q', "1,0 0,1 0,5 1,6 3,6 4,5 4,1 3,0 1,0|2,2 4,0"},
        {'R', "0,0 0,6 3,6 4,5 4,4 3,3 0,3|2,3 4,0"},
        {'S', "0,1 1,0 3,0 4,1 4,2 3,3 1,3 0,4 0,5 1,6 3,6 4,5"},
        {'T', "0,6 4,6|2,6 2,0"},
        {'U', "0,6 0,1 1,0 3,0 4,1 4,6"},
        {'V', "0,6 2,0 4,6"},
        {'W', "0,6 1,0 2,3 3,0 4,6"},
        {'X', "0,0 4,6|0,6 4,0"},
        {'Y', "0,6 2,3 4,6|2,3 2,0"},
        {'Z', "0,6 4,6 0,0 4,0"},
        {'0', "1,0 0,1 0,5 1,6 3,6 4,5 4,1 3,0 1,0|0,1 4,5"},
        {'1', "1,5 2,6 2,0|1,0 3,0"},
        {'2', "0,5 1,6 3,6 4,5 4,4 0,0 4,0"},
        {'3', "0,5 1,6 3,6 4,5 4,4 3,3 4,2 4,1 3,0 1,0 0,1|1,3 3,3"},
        {'4', "3,0 3,6 0,2 4,2"},
        {'5', "4,6 0,6 0,3 3,3 4,2 4,1 3,0 0,0"},
        {'6', "4,5 3,6 1,6 0,5 0,1 1,0 3,0 4,1 4,2 3,3 0,3"},
        {'7', "0,6 4,6 1,0"},
        {'8', "1,3 0,4 0,5 1,6 3,6 4,5 4,4 3,3 1,3 0,2 0,1 1,0 3,0 4,1 4,2 3,3"},
        {'9', "0,1 1,0 3,0 4,1 4,5 3,6 1,6 0,5 0,4 1,3 4,3"},
        {'+', "0,3 4,3|2,1 2,5"},
        {'-', "0,3 4,3"},
        {'.', "2,0 2,1"},
        {'_', "0,0 4,0"},
        {'/', "0,0 4,6"},
        {'#', "1,0 1,6|3,0 3,6|0,2 4,2|0,4 4,4"},
    };
    return font;
}
}  // namespace

double silkscreenTextWidth(const std::string& text, double height) {
    if (text.empty()) return 0;
    double u = height / 6;
    return (static_cast<double>(text.size()) * 6 - 2) * u;
}

std::vector<std::vector<Vec2>> silkscreenText(const std::string& text, Vec2 origin, double height, bool mirror) {
    std::vector<std::vector<Vec2>> strokes;
    const double u = height / 6;
    double advance = 0;
    for (char ch : text) {
        char key = static_cast<char>(std::toupper(static_cast<unsigned char>(ch)));
        auto it = strokeFont().find(key);
        if (it != strokeFont().end()) {
            std::vector<Vec2> stroke;
            auto flush = [&]() {
                if (stroke.size() >= 2) strokes.push_back(stroke);
                stroke.clear();
            };
            std::string spec = it->second;
            size_t i = 0;
            while (i < spec.size()) {
                if (spec[i] == '|') { flush(); ++i; continue; }
                if (spec[i] == ' ') { ++i; continue; }
                size_t comma = spec.find(',', i);
                size_t end = spec.find_first_of(" |", comma);
                if (end == std::string::npos) end = spec.size();
                double gx = std::stod(spec.substr(i, comma - i)), gy = std::stod(spec.substr(comma + 1, end - comma - 1));
                double dx = (advance + gx) * u;
                stroke.push_back({origin.x + (mirror ? -dx : dx), origin.y - gy * u});
                i = end;
            }
            flush();
        }
        advance += 6;
    }
    return strokes;
}

std::string exportIpcD356(const Schematic& sch, const PcbLayout& pcb, const std::string& jobName) {
    // Fixed-column records (IPC-D-356A): 317 = through hole, 327 = SMD; units CUST 1 = millimetres, 0.001 mm resolution.
    const auto& s = pcb.settings;
    const int bottom = s.bottomLayer();
    auto place = [](std::string& line, int col, const std::string& text) {
        for (size_t i = 0; i < text.size() && col - 1 + static_cast<int>(i) < static_cast<int>(line.size()); ++i)
            line[static_cast<size_t>(col - 1) + i] = text[i];
    };
    auto num = [](double v, int digits) {
        long long n = std::llround(std::fabs(v) * 1000);
        long long cap = 1;
        for (int i = 0; i < digits; ++i) cap *= 10;
        n = std::min(n, cap - 1);
        char b[16];
        std::snprintf(b, sizeof b, "%0*lld", digits, n);
        return std::string(b);
    };
    auto netName = [&](int net) {
        if (net < 0 || net >= static_cast<int>(sch.nets().size())) return std::string("N/C");
        std::string n = sch.nets()[static_cast<size_t>(net)].name;
        for (auto& ch : n)
            if (ch == ' ') ch = '_';
        return n.substr(0, 14);
    };
    auto record = [&](bool through, const std::string& net, const std::string& ref, const std::string& pin, double drill,
                      const std::string& access, Vec2 pos, double w, double h) {
        std::string line(80, ' ');
        place(line, 1, through ? "317" : "327");
        place(line, 4, net);
        place(line, 21, ref.substr(0, 6));
        place(line, 27, "-");
        place(line, 28, pin.substr(0, 4));
        if (through) {
            place(line, 33, "D" + num(drill, 4));
            place(line, 38, "P");
        }
        place(line, 39, access);
        place(line, 42, "X+" + num(pos.x, 6));
        double y = s.height - pos.y;
        place(line, 50, std::string("Y") + (y < 0 ? "-" : "+") + num(y, 6));
        place(line, 58, "X" + num(w, 4));
        place(line, 63, "Y" + num(h, 4));
        place(line, 68, "R000");
        place(line, 73, "S0");
        while (!line.empty() && line.back() == ' ') line.pop_back();
        return line + "\n";
    };
    std::ostringstream o;
    o << "C  IPC-D-356A netlist generated by SiEDA\n";
    o << "P  JOB   " << jobName << "\n";
    o << "P  UNITS CUST 1\n";
    o << "P  DIM   N\n";
    char layerCode[16];
    std::snprintf(layerCode, sizeof layerCode, "A%02d", bottom + 1);
    for (const auto& p : pcb.pads(sch)) {
        const Component* c = sch.find(p.componentId);
        if (!c) continue;
        o << record(p.throughHole, netName(p.net), c->ref, std::to_string(p.padNumber), p.drill,
                    p.throughHole ? "A00" : (p.smdLayer == kTopLayer ? "A01" : layerCode), p.position, p.size.x, p.size.y);
    }
    for (const auto& v : pcb.vias) o << record(true, netName(v.net), "VIA", "", v.drill, "A00", v.position, v.diameter, v.diameter);
    o << "999\n";
    return o.str();
}

std::string exportAssemblyBomCsv(const Schematic& sch) {
    // Fitted parts only (DNP lines are left off), with the part numbers entered in the BOM workspace.
    std::ostringstream o;
    o << "Comment,Designator,Footprint,Quantity,LCSC Part #,Manufacturer Part #\n";
    for (const auto& l : buildBom(sch)) {
        if (l.sourcing.dnp || l.embedded) continue;  // embedded passives are made in the PCB
        std::string joined;
        for (size_t i = 0; i < l.refs.size(); ++i) joined += (i ? "," : "") + l.refs[i];
        o << csvEscape(l.value.empty() ? l.type : l.value) << "," << csvEscape(joined) << "," << csvEscape(l.footprint) << ","
          << l.quantity() << "," << csvEscape(l.sourcing.supplierPart) << "," << csvEscape(l.sourcing.mpn) << "\n";
    }
    return o.str();
}

std::string exportCplCsv(const Schematic& sch, const PcbLayout& pcb) {
    std::ostringstream o;
    o << "Designator,Mid X,Mid Y,Layer,Rotation\n";
    for (const auto& c : sch.components()) {
        // DNP parts are not placed; embedded passives are made by the board house, not assembled.
        if (!c.hasFootprint() || !c.pcb.placed || c.sourcing.dnp || c.pcb.embedded()) continue;
        // Same origin as the Gerbers: the board's lower-left corner, Y up.
        o << c.ref << "," << mm(c.pcb.position.x) << "mm,";
        o << mm(pcb.settings.height - c.pcb.position.y) << "mm," << (c.pcb.bottom ? "Bottom" : "Top") << "," << c.pcb.rotation << "\n";
    }
    return o.str();
}

std::string exportAssemblySvg(const Schematic& sch, const PcbLayout& pcb, bool bottom, const std::string& title) {
    const auto& s = pcb.settings;
    const double margin = 6, titleH = 8;
    std::ostringstream o;
    char head[512];
    std::snprintf(head, sizeof head,
                  "<svg xmlns=\"http://www.w3.org/2000/svg\" width=\"%.1fmm\" height=\"%.1fmm\" viewBox=\"%.3f %.3f %.3f %.3f\">\n",
                  s.width + 2 * margin, s.height + 2 * margin + titleH, -margin, -margin - titleH, s.width + 2 * margin,
                  s.height + 2 * margin + titleH);
    o << head;
    o << "<rect x=\"" << -margin << "\" y=\"" << -margin - titleH << "\" width=\"" << s.width + 2 * margin << "\" height=\""
      << s.height + 2 * margin + titleH << "\" fill=\"white\"/>\n";
    auto esc = [](std::string t) {
        std::string out;
        for (char ch : t) {
            if (ch == '<') out += "&lt;";
            else if (ch == '>') out += "&gt;";
            else if (ch == '&') out += "&amp;";
            else out += ch;
        }
        return out;
    };
    o << "<text x=\"0\" y=\"" << -margin - titleH / 2 + 1 << "\" font-family=\"Helvetica, Arial\" font-size=\"3\" "
      << "fill=\"#111\">" << esc(title) << " — assembly drawing, " << (bottom ? "bottom side (seen from below)" : "top side")
      << "</text>\n";
    // Bottom-side drawings are mirrored so they match the board turned over.
    o << "<g" << (bottom ? " transform=\"translate(" + mm(s.width) + ",0) scale(-1,1)\"" : std::string()) << ">\n";
    o << "<polygon fill=\"#f4f4ef\" stroke=\"#222\" stroke-width=\"0.2\" points=\"";
    for (const auto& v : s.outlinePolygon()) o << mm(v.x) << "," << mm(v.y) << " ";
    o << "\"/>\n";
    for (const auto& h : s.holes)
        o << "<circle cx=\"" << mm(h.position.x) << "\" cy=\"" << mm(h.position.y) << "\" r=\"" << mm(h.drill / 2)
          << "\" fill=\"white\" stroke=\"#222\" stroke-width=\"0.15\"/>\n";
    for (const auto& p : pcb.pads(sch)) {
        const Component* c = sch.find(p.componentId);
        if (!c || c->pcb.bottom != bottom || c->pcb.embedded()) continue;
        o << "<rect x=\"" << mm(p.position.x - p.size.x / 2) << "\" y=\"" << mm(p.position.y - p.size.y / 2) << "\" width=\""
          << mm(p.size.x) << "\" height=\"" << mm(p.size.y) << "\" fill=\"#c9c9c9\"/>\n";
    }
    for (const auto& c : sch.components()) {
        if (!c.hasFootprint() || !c.pcb.placed || c.pcb.bottom != bottom || c.pcb.embedded()) continue;
        Rect r = pcb.courtyard(c).inflated(-0.15);
        o << "<rect x=\"" << mm(r.x0) << "\" y=\"" << mm(r.y0) << "\" width=\"" << mm(r.x1 - r.x0) << "\" height=\""
          << mm(r.y1 - r.y0) << "\" fill=\"none\" stroke=\"#1b4f9c\" stroke-width=\"0.15\"/>\n";
        const FootprintDef* fp = Library::instance().footprint(c.footprintName());
        if (fp && !fp->pads.empty()) {
            Vec2 p1 = c.pcb.position + rotate90(fp->pads[0].offset, c.pcb.rotation);
            o << "<circle cx=\"" << mm(p1.x) << "\" cy=\"" << mm(p1.y) << "\" r=\"0.25\" fill=\"#c0392b\"/>\n";
        }
        double size = std::max(0.8, std::min(2.0, std::min(r.x1 - r.x0, r.y1 - r.y0) * 0.45));
        o << "<text x=\"" << mm((r.x0 + r.x1) / 2) << "\" y=\"" << mm((r.y0 + r.y1) / 2 + size * 0.35) << "\" font-size=\""
          << mm(size) << "\" font-family=\"Helvetica, Arial\" text-anchor=\"middle\" fill=\"#111\""
          << (bottom ? " transform=\"translate(" + mm(r.x0 + r.x1) + ",0) scale(-1,1)\"" : std::string()) << ">"
          << esc(c.ref) << "</text>\n";
    }
    o << "</g>\n</svg>\n";
    return o.str();
}

std::string exportStl(const Mesh& mesh, const std::string& name) {
    std::ostringstream o;
    o << "solid " << name << "\n";
    char buf[160];
    for (size_t t = 0; t + 2 < mesh.indices.size(); t += 3) {
        uint32_t i0 = mesh.indices[t], i1 = mesh.indices[t + 1], i2 = mesh.indices[t + 2];
        auto v = [&](uint32_t i) {
            return Vec3{mesh.positions[i * 3], mesh.positions[i * 3 + 1], mesh.positions[i * 3 + 2]};
        };
        Vec3 a = v(i0), b = v(i1), c = v(i2);
        Vec3 n = (b - a).cross(c - a);
        if (n.length() < 1e-12) continue;  // skip degenerate triangles
        n = n.normalized();
        std::snprintf(buf, sizeof buf, "facet normal %g %g %g\n", n.x, n.y, n.z);
        o << buf << " outer loop\n";
        for (const Vec3& p : {a, b, c}) {
            std::snprintf(buf, sizeof buf, "  vertex %g %g %g\n", p.x, p.y, p.z);
            o << buf;
        }
        o << " endloop\nendfacet\n";
    }
    o << "endsolid " << name << "\n";
    return o.str();
}

std::string exportObj(const Mesh& mesh, const std::string& name) {
    std::ostringstream o;
    o << "# SiEDA 3D export\no " << name << "\n";
    char buf[200];
    for (size_t i = 0; i < mesh.vertexCount(); ++i) {
        // Vertex colours as the widely supported "v x y z r g b" extension.
        std::snprintf(buf, sizeof buf, "v %g %g %g %.3f %.3f %.3f\n", mesh.positions[i * 3], mesh.positions[i * 3 + 1],
                      mesh.positions[i * 3 + 2], mesh.colors[i * 4], mesh.colors[i * 4 + 1], mesh.colors[i * 4 + 2]);
        o << buf;
    }
    for (size_t i = 0; i < mesh.vertexCount(); ++i) {
        std::snprintf(buf, sizeof buf, "vn %g %g %g\n", mesh.normals[i * 3], mesh.normals[i * 3 + 1], mesh.normals[i * 3 + 2]);
        o << buf;
    }
    for (size_t t = 0; t + 2 < mesh.indices.size(); t += 3) {
        uint32_t a = mesh.indices[t] + 1, b = mesh.indices[t + 1] + 1, c = mesh.indices[t + 2] + 1;
        if (a == b || b == c || a == c) continue;
        o << "f " << a << "//" << a << " " << b << "//" << b << " " << c << "//" << c << "\n";
    }
    return o.str();
}

}  // namespace sieda
