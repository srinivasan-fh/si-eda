// Generated by Core/tests/firmware/build.sh from Core/tests/firmware — Intel HEX images (do not edit).
const char* const kHex_adc_pwm =
    ":100000000C9434000C943E000C943E000C943E0082\n"
    ":100010000C943E000C943E000C943E000C943E0068\n"
    ":100020000C943E000C943E000C943E000C943E0058\n"
    ":100030000C943E000C943E000C943E000C943E0048\n"
    ":100040000C943E000C943E000C943E000C943E0038\n"
    ":100050000C943E000C943E000C943E000C943E0028\n"
    ":100060000C943E000C943E0011241FBECFEFD8E04C\n"
    ":10007000DEBFCDBF0E9440000C94DE000C94000057\n"
    ":10008000CF93DF93CDB7DEB72B970FB6F894DEBFD3\n"
    ":100090000FBECDBF1092C50088E08093C4001092BF\n"
    ":1000A000C0008093C10086E08093C20087E88093FF\n"
    ":1000B0007A00569A83E884BD82E085BD219A81E862\n"
    ":1000C0008093800081E08093810080E490E09093B1\n"
    ":1000D00089008093880030E4A32ECE0101967C0134\n"
    ":1000E0004AE0442E512C612C712C5AE0B52EA0927E\n"
    ":1000F0007C0080917A00806480937A0080917A00FD\n"
    ":1001000086FDFCCF6091780070917900CB019695C7\n"
    ":1001100087959695879587BD90E080E0670110E010\n"
    ":1001200000E00F5F1F4FA30192010E94BC00605DC1\n"
    ":10013000F60161936F01B901CA016115710581056D\n"
    ":10014000910579F7F701E00FF11F82919091C000BE\n"
    ":1001500095FFFCCF8093C600EE16FF06B1F78091A5\n"
    ":10016000C00085FFFCCFB092C6008FE39CE90197E9\n"
    ":10017000F1F700C00000BBCFA1E21A2EAA1BBB1BE7\n"
    ":10018000FD010DC0AA1FBB1FEE1FFF1FA217B30763\n"
    ":10019000E407F50720F0A21BB30BE40BF50B661F79\n"
    ":1001A000771F881F991F1A9469F76095709580953D\n"
    ":1001B00090959B01AC01BD01CF010895F894FFCF4C\n"
    ":00000001FF\n"
    ;
const char* const kHex_alu =
    ":100000000C9434000C9449000C9449000C94490061\n"
    ":100010000C9449000C9449000C9449000C9449003C\n"
    ":100020000C9449000C9449000C9449000C9449002C\n"
    ":100030000C9449000C9449000C9449000C9449001C\n"
    ":100040000C9449000C9449000C9449000C9449000C\n"
    ":100050000C9449000C9449000C9449000C944900FC\n"
    ":100060000C9449000C94490011241FBECFEFD8E036\n"
    ":10007000DEBFCDBF11E0A0E0B1E0E6EDF3E102C0EC\n"
    ":1000800005900D92AA32B107D9F70E94E6000C94B0\n"
    ":10009000E9090C9400009091C00095FFFCCF80937B\n"
    ":1000A000C60008958F929F92AF92BF92CF92DF9237\n"
    ":1000B000EF92FF920F931F93CF93DF93CDB7DEB7ED\n"
    ":1000C0002B970FB6F894DEBF0FBECDBF9E012F5FFA\n"
    ":1000D0003F4F7901690110E000E02AE0822E912C67\n"
    ":1000E000A12CB12C0F5F1F4FA50194010E943E056A\n"
    ":1000F000605DF60161936F01B901CA016115710577\n"
    ":100100008105910579F70E0D1F1DF80182918F0170\n"
    ":100110000E944B000E151F05C1F72B960FB6F894E1\n"
    ":10012000DEBF0FBECDBFDF91CF911F910F91FF902A\n"
    ":10013000EF90DF90CF90BF90AF909F908F900895F9\n"
    ":10014000CF92DF92EF92FF92CF93DF93D82FC82FF9\n"
    ":10015000C12CD12C7601C23074F4D170C701B60124\n"
    ":100160006D0F711D811D911DDF91CF91FF90EF905B\n"
    ":10017000DF90CF9008958FEF8C0F0E94A000C60EE5\n"
    ":10018000D71EE81EF91EC250E6CFFC018081918186\n"
    ":10019000FB0120813181821B930B0895CF92DF9266\n"
    ":1001A000EF92FF9297FF0CC06B017C018DE20E94E1\n"
    ":1001B0004B0066277727CB016C197D098E099F09B3\n"
    ":1001C000FF90EF90DF90CF900C945200CF93DF938D\n"
    ":1001D000CDB7DEB7C455D1090FB6F894DEBF0FBE58\n"
    ":1001E000CDBF1092C50081E08093C40082E080936F\n"
    ":1001F000C00088E08093C10086E08093C2008CE953\n"
    ":1002000065968FAF65978DE464968FAF649788ECA1\n"
    ":1002100063968FAF639783E662968FAF629787ECA2\n"
    ":100220009FEC61969FAF8EAF619781E491E02F962E\n"
    ":100230009FAF8EAF2F9780E69AEE2D969FAF8EAF31\n"
    ":100240002D9787E090E02B969FAF8EAF2B978FE492\n"
    ":1002500097E9A1E2B5EC29968CAF9DAFAEAFBFAFE9\n"
    ":10026000299789E390E3A0E0B0E025968CAF9DAF9D\n"
    ":10027000AEAFBFAF259780E098E2ABE6BEEE219629\n"
    ":100280008CAF9DAFAEAFBFAF219781E090E0DC01B6\n"
    ":1002900089AF9AAFABAFBCAF65966FAD659764960B\n"
    ":1002A0008FAD6497680F062E000C770B880B990BA7\n"
    ":1002B0000E94CE008AE00E944B0065966FAD659764\n"
    ":1002C00064968FAD6497681B062E000C770B880B25\n"
    ":1002D000990B0E94CE008AE00E944B0065966FAD9C\n"
    ":1002E000659764968FAD64976802B0011124072E5C\n"
    ":1002F000000C880B990B0E94CE008AE00E944B00F4\n"
    ":1003000065968FAD659717E0612F0E940805682FED\n"
    ":10031000880F770B880B990B0E94CE008AE00E9411\n"
    ":100320004B0065968FAD6597612F0E940805692F78\n"
    ":10033000990F770B880B990B0E94CE008AE00E94E0\n"
    ":100340004B0063966FAD639762968FAD6297680FAF\n"
    ":1003500070E090E080E00E9452008AE00E944B0032\n"
    ":1003600063966FAD639762968FAD6297689F602DBD\n"
    ":10037000112470E090E080E00E9452008AE00E9428\n"
    ":100380004B0063968FAD639762966FAD62970E9444\n"
    ":10039000FC04682F70E090E080E00E9452008AE048\n"
    ":1003A0000E944B0063968FAD639762966FAD629724\n"
    ":1003B0000E94FC04692F70E090E080E00E945200EF\n"
    ":1003C0008AE00E944B0063966FAD6397660F660FDD\n"
    ":1003D000660F70E090E080E00E9452008AE00E9488\n"
    ":1003E0004B0063966FAD639766956695669570E072\n"
    ":1003F00090E080E00E9452008AE00E944B006596E7\n"
    ":100400006FAD659765956595062E000C770B880B8B\n"
    ":10041000990B0E94CE008AE00E944B0061966EAD5F\n"
    ":100420007FAD61972F968EAD9FAD2F97680F791F87\n"
    ":10043000072E000C880B990B0E94CE008AE00E94C8\n"
    ":100440004B0061962EAD3FAD61972F968EAD9FAD5F\n"
    ":100450002F97289FB001299F700D389F700D112490\n"
    ":10046000072E000C880B990B0E94CE008AE00E9498\n"
    ":100470004B0061968EAD9FAD61972F966EAD7FADAF\n"
    ":100480002F970E942A05072E000C880B990B0E94BB\n"
    ":10049000CE008AE00E944B0061968EAD9FAD6197C1\n"
    ":1004A0002F966EAD7FAD2F970E942A05BC01990F44\n"
    ":1004B000880B990B0E94CE008AE00E944B00619647\n"
    ":1004C0006EAD7FAD6197F3E075956795FA95E1F7AD\n"
    ":1004D000072E000C880B990B0E94CE008AE00E9428\n"
    ":1004E0004B002D962EAD3FAD2D972B968EAD9FAD2B\n"
    ":1004F0002B97289FB001299F700D389F700D1124F4\n"
    ":1005000090E080E00E9452008AE00E944B002D960D\n"
    ":100510008EAD9FAD2D972B966EAD7FAD2B970E9424\n"
    ":10052000160590E080E00E9452008AE00E944B0095\n"
    ":100530002D968EAD9FAD2D972B966EAD7FAD2B97E3\n"
    ":100540000E941605BC0190E080E00E9452008AE003\n"
    ":100550000E944B002D966EAD7FAD2D97A5E0660FE6\n"
    ":10056000771FAA95E1F790E080E00E9452008AE0B0\n"
    ":100570000E944B0029966CAD7DAD8EAD9FAD299745\n"
    ":1005800025960CAD1DAD2EAD3FAD2597600F711FAB\n"
    ":10059000821F931F0E94CE008AE00E944B00299682\n"
    ":1005A0002CAD3DAD4EAD5FAD299725966CAD7DADC3\n"
    ":1005B0008EAD9FAD25970E94EC040E94CE008AE08C\n"
    ":1005C0000E944B0029966CAD7DAD8EAD9FAD2997F5\n"
    ":1005D00025962CAD3DAD4EAD5FAD25970E946005D3\n"
    ":1005E000CA01B9010E94CE008AE00E944B00299600\n"
    ":1005F0006CAD7DAD8EAD9FAD299725962CAD3DADF3\n"
    ":100600004EAD5FAD25970E9460050E94CE008AE046\n"
    ":100610000E944B0029966CAD7DAD8EAD9FAD2997A4\n"
    ":10062000B7E09595879577956795BA95D1F70E942C\n"
    ":10063000CE008AE00E944B0021966CAD7DAD8EAD60\n"
    ":100640009FAD219709AD1AAD2BAD3CAD600F711F69\n"
    ":10065000821F931F0E9452008AE00E944B00219645\n"
    ":100660002CAD3DAD4EAD5FAD219769AD7AAD8BAD93\n"
    ":100670009CAD0E94EC040E9452008AE00E944B0054\n"
    ":1006800021966CAD7DAD8EAD9FAD219729AD3AAD74\n"
    ":100690004BAD5CAD0E943E05CA01B9010E945200FB\n"
    ":1006A0008AE00E944B0021966CAD7DAD8EAD9FAD72\n"
    ":1006B000219729AD3AAD4BAD5CAD0E943E050E943D\n"
    ":1006C00052008AE00E944B0021966CAD7DAD8EAD4C\n"
    ":1006D0009FAD21971DE096958795779567951A951B\n"
    ":1006E000D1F70E9452008AE00E944B0061962EAD25\n"
    ":1006F0003FAD61972F96AEADBFAD2F970E947F059E\n"
    ":100700000E94CE008AE00E944B002D962EAD3FAD98\n"
    ":100710002D972D96AEADBFAD2D970E9487050E94F7\n"
    ":1007200052008AE00E944B0015E0209100013091B8\n"
    ":10073000010140910201509103016DE67EE486ECD7\n"
    ":1007400091E40E94EC04675C7F4C8F4F9F4F609355\n"
    ":100750000001709301018093020190930301609165\n"
    ":1007600000017091010180910201909103010E94AA\n"
    ":1007700052008AE00E944B001150B9F68FE00E94AF\n"
    ":10078000A0000E94CE008AE00E944B0069E17BE35A\n"
    ":1007900080E090E00E94CE008AE00E944B0068E377\n"
    ":1007A0007EEF8FEF9FEF0E94CE008AE00E944B0009\n"
    ":1007B00080ED9FE0A9E4B0E48DAB9EABAFABB8AFEA\n"
    ":1007C00080E090E0A0E2B0EC89AB9AABABABBCAB05\n"
    ":1007D0006DA97EA98FA998AD20E030E04AE754E4E6\n"
    ":1007E0000E9474070E948C060E94CE008AE00E943C\n"
    ":1007F0004B006DA97EA98FA998AD29A93AA94BA94B\n"
    ":100800005CA90E94A90520E030E543EC57E40E9472\n"
    ":1008100074070E948C060E94CE008AE00E944B0062\n"
    ":100820006DA97EA98FA998AD29A93AA94BA95CA960\n"
    ":100830000E941A0620E034E244E759E40E9474075B\n"
    ":100840000E948C060E94CE008AE00E944B006DA997\n"
    ":100850007EA98FA998AD2DA93EA94FA958ADCDA8C5\n"
    ":10086000DEA8EFA8F8AC0E947407A70196010E94C9\n"
    ":10087000740720E030E04AE754E40E9474070E94C5\n"
    ":100880008C060E94CE008AE00E944B0069A97AA9DA\n"
    ":100890008BA99CA92DA93EA94FA958ADC12CD12C3B\n"
    ":1008A0007601C3940E94150687FD03C0C12CD12C8C\n"
    ":1008B0007601C701B6010E94CE008AE00E944B007B\n"
    ":1008C00029966CAD7DAD8EAD9FAD29970E94C40673\n"
    ":1008D00020E030E04AE754E40E941A060E948C06A9\n"
    ":1008E0000E94CE008AE00E944B0064E171E08E011C\n"
    ":1008F0000F5F1F4FC8010E94AB096FE171E0C80193\n"
    ":100900000E949709F80101900020E9F73197E01B58\n"
    ":10091000F10BBF0190E080E00E94CE008AE00E94CF\n"
    ":100920004B006AE171E0C8010E94A209BC01990F65\n"
    ":10093000880B990B0E94CE008AE00E944B00F801C0\n"
    ":1009400081918F018111F9CF8AE00E944B0080E1F3\n"
    ":10095000E4E0F1E0DE01919601900D928A95E1F7D5\n"
    ":1009600025EC30E042E050E068E070E0CE01819696\n"
    ":100970000E942A088E010F5D1F4F7E01F1E3EF0EEA\n"
    ":10098000F11CF801619171918F01072E000C880B09\n"
    ":10099000990B0E94CE008AE00E944B000E151F05A5\n"
    ":1009A00081F7089498946FB7637070E090E080E0EE\n"
    ":1009B0000E9452008AE00E944B0004E211E0F8011C\n"
    ":1009C00081918F01811105C08091C00086FFFCCF0D\n"
    ":1009D000FFCF0E944B00F3CFDB018F939F930E94C8\n"
    ":1009E0009D05BF91AF91A29F800D911DA39F900D7A\n"
    ":1009F000B29F900D11240895991B79E004C0991FAE\n"
    ":100A0000961708F0961B881F7A95C9F78095089568\n"
    ":100A100087FB082E062687FD819567FD61950E945C\n"
    ":100A2000FC040EF4919507FC81950895AA1BBB1B4D\n"
    ":100A300051E107C0AA1FBB1FA617B70710F0A61BDE\n"
    ":100A4000B70B881F991F5A95A9F780959095BC01FF\n"
    ":100A5000CD01089597FB072E16F4009407D077FD7B\n"
    ":100A600009D00E94160507FC05D03EF490958195AB\n"
    ":100A70009F4F0895709561957F4F0895A1E21A2EBA\n"
    ":100A8000AA1BBB1BFD010DC0AA1FBB1FEE1FFF1F32\n"
    ":100A9000A217B307E407F50720F0A21BB30BE40B82\n"
    ":100AA000F50B661F771F881F991F1A9469F76095C9\n"
    ":100AB0007095809590959B01AC01BD01CF01089583\n"
    ":100AC000052E97FB1EF400940E94770557FD07D072\n"
    ":100AD0000E943E0507FC03D04EF40C947705509518\n"
    ":100AE0004095309521953F4F4F4F5F4F089590951A\n"
    ":100AF0008095709561957F4F8F4F9F4F08950E940D\n"
    ":100B00008705332312F48A1B9B0B0C949805A29F34\n"
    ":100B1000B001B39FC001A39F700D811D1124911DD1\n"
    ":100B2000B29F700D811D1124911D08950E948705AB\n"
    ":100B3000B7FF0895821B930B08950E948705A59F18\n"
    ":100B4000900DB49F900DA49F800D911D11240895C8\n"
    ":100B50005058BB27AA270E94C0050C943A070E9450\n"
    ":100B60002C0738F00E94330720F039F49F3F19F426\n"
    ":100B700026F40C9429070EF4E095E7FB0C94230768\n"
    ":100B8000E92F0E944B0758F3BA17620773078407CF\n"
    ":100B9000950720F079F4A6F50C946D070EF4E09516\n"
    ":100BA0000B2EBA2FA02D0B01B90190010C01CA0127\n"
    ":100BB000A0011124FF27591B99F0593F50F4503ED2\n"
    ":100BC00068F11A16F040A22F232F342F4427585FC4\n"
    ":100BD000F3CF469537952795A795F0405395C9F7DC\n"
    ":100BE0007EF41F16BA0B620B730B840BBAF0915094\n"
    ":100BF000A1F0FF0FBB1F661F771F881FC2F70EC033\n"
    ":100C0000BA0F621F731F841F48F487957795679505\n"
    ":100C1000B795F7959E3F08F0B0CF9395880F08F0F1\n"
    ":100C20009927EE0F9795879508950E94FF0608F47F\n"
    ":100C300081E008950E942E060C943A070E94330723\n"
    ":100C400058F00E942C0740F029F45F3F29F00C94E3\n"
    ":100C5000230751110C946E070C9429070E944B072F\n"
    ":100C600068F39923B1F3552391F3951B550BBB27DB\n"
    ":100C7000AA2762177307840738F09F5F5F4F220F20\n"
    ":100C8000331F441FAA1FA9F335D00E2E3AF0E0E817\n"
    ":100C900032D091505040E695001CCAF72BD0FE2F61\n"
    ":100CA00029D0660F771F881FBB1F261737074807F5\n"
    ":100CB000AB07B0E809F0BB0B802DBF01FF279358AD\n"
    ":100CC0005F4F3AF09E3F510578F00C9423070C9447\n"
    ":100CD0006E075F3FE4F3983ED4F38695779567956A\n"
    ":100CE000B795F7959F5FC9F7880F911D96958795E2\n"
    ":100CF00097F90895E1E0660F771F881FBB1F621701\n"
    ":100D000073078407BA0720F0621B730B840BBA0BBE\n"
    ":100D1000EE1F88F7E09508950E9493066894B1113C\n"
    ":100D20000C946E0708950E94530788F09F5798F01F\n"
    ":100D3000B92F9927B751B0F0E1F0660F771F881FE0\n"
    ":100D4000991F1AF0BA95C9F714C0B13091F00E94FA\n"
    ":100D50006D07B1E008950C946D07672F782F8827F1\n"
    ":100D6000B85F39F0B93FCCF3869577956795B39521\n"
    ":100D7000D9F73EF490958095709561957F4F8F4F90\n"
    ":100D80009F4F0895E89409C097FB3EF49095809595\n"
    ":100D9000709561957F4F8F4F9F4F9923A9F0F92F41\n"
    ":100DA00096E9BB279395F695879577956795B795BF\n"
    ":100DB000F111F8CFFAF4BB0F11F460FF1BC06F5FA5\n"
    ":100DC0007F4F8F4F9F4F16C0882311F096E911C0B7\n"
    ":100DD000772321F09EE8872F762F05C0662371F0D8\n"
    ":100DE00096E8862F70E060E02AF09A95660F771FEC\n"
    ":100DF000881FDAF7880F9695879597F90895990FC8\n"
    ":100E00000008550FAA0BE0E8FEEF16161706E807D4\n"
    ":100E1000F907C0F012161306E407F50798F0621BF5\n"
    ":100E2000730B840B950B39F40A2661F0232B242BCA\n"
    ":100E3000252B21F408950A2609F4A140A6958FEFE9\n"
    ":100E4000811D811D089597F99F6780E870E060E03B\n"
    ":100E500008959FEF80EC089500240A941616170653\n"
    ":100E600018060906089500240A941216130614069B\n"
    ":100E700005060895092E0394000C11F4882352F0FE\n"
    ":100E8000BB0F40F4BF2B11F460FF04C06F5F7F4FB6\n"
    ":100E90008F4F9F4F089557FD9058440F551F59F09D\n"
    ":100EA0005F3F71F04795880F97FB991F61F09F3F57\n"
    ":100EB00079F087950895121613061406551FF2CF80\n"
    ":100EC0004695F1DF08C0161617061806991FF1CFD0\n"
    ":100ED00086957105610508940895E894BB276627F7\n"
    ":100EE0007727CB0197F908950E9487070C943A075A\n"
    ":100EF0000E942C0738F00E94330720F0952311F050\n"
    ":100F00000C9423070C94290711240C946E070E945B\n"
    ":100F10004B0770F3959FC1F3950F50E0551F629FEB\n"
    ":100F2000F001729FBB27F00DB11D639FAA27F00D42\n"
    ":100F3000B11DAA1F649F6627B00DA11D661F829F69\n"
    ":100F40002227B00DA11D621F739FB00DA11D621F4E\n"
    ":100F5000839FA00D611D221F749F3327A00D611D6B\n"
    ":100F6000231F849F600D211D822F762F6A2F11244D\n"
    ":100F70009F5750409AF0F1F088234AF0EE0FFF1F80\n"
    ":100F8000BB1F661F771F881F91505040A9F79E3FD7\n"
    ":100F9000510580F00C9423070C946E075F3FE4F337\n"
    ":100FA000983ED4F3869577956795B795F795E7952D\n"
    ":100FB0009F5FC1F7FE2B880F911D9695879597F936\n"
    ":100FC0000895CF93DF93DC012D91FB013191EC016A\n"
    ":100FD0003883EB01288341505109CD01BF0114161C\n"
    ":100FE00015068CF3DF91CF910895B0E0A0E0EBEF10\n"
    ":100FF000F7E00C94BC096C01D62FC72F8A01790148\n"
    ":10100000F9010995B80197FF15C08D2F9C2FF701A5\n"
    ":10101000099597FD08C0B801C601F701099597FD2C\n"
    ":1010200016C0DC2DCD2D8D2F9C2FCDB7DEB7E8E07F\n"
    ":101030000C94D8098D2F9C2FF701099518161906C5\n"
    ":1010400094F3B801C601F701099597FDEACFD02FB7\n"
    ":10105000C12FE9CFA8E0B0E0E0E3F8E00C94B209DA\n"
    ":101060008C0158874F8359019A0131952195310997\n"
    ":101070003E832D836F807884600E711E673071050A\n"
    ":1010800078F58F819885689F6001699FD00C789F63\n"
    ":10109000D00C1124C00ED11E6C147D0420F02896B3\n"
    ":1010A000E2E10C94CE09730113C047012F8138850A\n"
    ":1010B000821A930AB701C401F50109951816190699\n"
    ":1010C00054F44F815885B401C7010E94E1077401AF\n"
    ":1010D0000E151F0550F3EF81F8856E0E7F1EDCCFD5\n"
    ":1010E000CB01969587952F813885829F6001839FDC\n"
    ":1010F000D00C929FD00C1124C00ED11ECB010197B1\n"
    ":10110000829F1001839F300C929F300C1124780134\n"
    ":10111000E20CF31C6730710509F442C0C7012801D5\n"
    ":1011200069327105B0F183E0769567958A95E1F7AC\n"
    ":10113000629F4001639F900C729F900C1124C40128\n"
    ":10114000880F991F9A838983AC01400F511FB80102\n"
    ":10115000680D791D9501C8010E94F5072C01A601B3\n"
    ":10116000480D591D9194819491089501B601C601CD\n"
    ":10117000880D991D0E94F5076C01B701680D791D56\n"
    ":101180009501A701C701E981FA818E1B9F0B0E947F\n"
    ":10119000F5079501AC01B601C2010E94F5076C018B\n"
    ":1011A0004F815885B601C8010E94E10743016301E0\n"
    ":1011B00027011A821982EC14FD0408F446C0B80114\n"
    ":1011C000C601F50109951816190654F1892B71F419\n"
    ":1011D0004F815885B601C3010E94E1072F813885F0\n"
    ":1011E000620E731E81E090E09A838983EF81F88517\n"
    ":1011F000CE0EDF1EE0CF892B71F44F815885B201EE\n"
    ":10120000C7010E94E1072D813E81420E531E81E0FD\n"
    ":1012100090E09A838983EB80FC80EC14FD04A8F0B5\n"
    ":10122000B801C701F50109952D813E812E0D3F1DA5\n"
    ":101230003C832B8397FFDFCF4F815885B701C601D1\n"
    ":101240000E94E107EB80FC80CDCFEF81F8852E0E68\n"
    ":101250003F1E200E311E29813A81232B09F582146D\n"
    ":10126000930408F01CCF740113C06701EF81F88567\n"
    ":10127000CE1ADF0AB701C601F5010995181619063D\n"
    ":1012800054F44F815885B601C7010E94E1077601E9\n"
    ":101290000E151F0550F38F819885880E991EDFCF9C\n"
    ":1012A000460186189708A301401B510B841695062A\n"
    ":1012B0000CF4A4011416150634F4B601641B750B66\n"
    ":1012C000C8010E94E10792012E193F097901A1018D\n"
    ":1012D000441955098F819885481B590B24173507E8\n"
    ":1012E00008F4A9011416150634F4B101641B750B3A\n"
    ":1012F000C6010E94E107EF81F885E815F90548F479\n"
    ":10130000C401BF010E9416059501AF01C8010E94EA\n"
    ":101310002A082F8138852E153F0508F0C0CE81019F\n"
    ":101320000E191F09C701B9010E941605A3CEFB01C2\n"
    ":10133000DC010D900020E9F7119701900D9200203B\n"
    ":10134000E1F70895FB01DC018D91019080190110F6\n"
    ":10135000D9F3990B0895FB01DC0101900D92002057\n"
    ":10136000E1F708952F923F924F925F926F927F9292\n"
    ":101370008F929F92AF92BF92CF92DF92EF92FF92A5\n"
    ":101380000F931F93CF93DF93CDB7DEB7CA1BDB0B51\n"
    ":101390000FB6F894DEBF0FBECDBF09942A883988F6\n"
    ":1013A00048885F846E847D848C849B84AA84B984FD\n"
    ":1013B000C884DF80EE80FD800C811B81AA81B98109\n"
    ":1013C000CE0FD11D0FB6F894DEBF0FBECDBFED011D\n"
    ":0613D0000895F894FFCF20\n"
    ":1013D600393000000500FDFF090000001600EFFF90\n"
    ":1013E6000400040053694544410053694544412DB6\n"
    ":0A13F60041565200454E440A000023\n"
    ":00000001FF\n"
    ;
const char* const kHex_arduino_AnalogSerial =
    ":100000000C945D000C9485000C9485000C94850084\n"
    ":100010000C9485000C9485000C9485000C9485004C\n"
    ":100020000C9485000C9485000C9485000C9485003C\n"
    ":100030000C9485000C9485000C9485000C9485002C\n"
    ":100040000C94A0030C9485000C9400020C943202D2\n"
    ":100050000C9485000C9485000C9485000C9485000C\n"
    ":100060000C9485000C94850000000008000201003B\n"
    ":100070000003040700000000000000000102040863\n"
    ":100080001020408001020408102001020408102002\n"
    ":10009000040404040404040402020202020203032E\n"
    ":1000A0000303030300000000250028002B000000CC\n"
    ":1000B0000000240027002A00620211241FBECFEF97\n"
    ":1000C000D8E0DEBFCDBF11E0A0E0B1E0EAE8FBE0A0\n"
    ":1000D00002C005900D92A631B107D9F721E0A6E143\n"
    ":1000E000B1E001C01D92AC3BB207E1F710E0CDE5F5\n"
    ":1000F000D0E004C02197FE010E94BD05CC35D10798\n"
    ":10010000C9F70E9491030C94C3050C94000026E0EB\n"
    ":1001100040E052EC61E070E086E191E00E949E01D7\n"
    ":1001200061E089E00C943005CF93DF938EE00E946C\n"
    ":100130008F04EC01BC0197FF02C06D5F7F4F759586\n"
    ":1001400067957595679589E00E94AA040E94EA0365\n"
    ":10015000AB01BC012AE030E086E191E00E9483031C\n"
    ":1001600060E286E191E00E94CB024AE050E0BE01ED\n"
    ":1001700086E191E00E94710362E370E080E090E02C\n"
    ":10018000DF91CF910C941B04FC01918D228D892F5E\n"
    ":1001900090E0805C9F4F821B91098F73992708958F\n"
    ":1001A000FC01918D828D981731F0828DE80FF11D41\n"
    ":1001B000858D90E008958FEF9FEF0895FC01918D5C\n"
    ":1001C000828D981761F0A28DAE0FBF2FB11D5D9685\n"
    ":1001D0008C91928D9F5F9F73928F90E008958FEF27\n"
    ":1001E0009FEF0895FC01538D448D252F30E0842F1F\n"
    ":1001F00090E0821B930B541710F0CF96089501974F\n"
    ":10020000089588E592E0892B49F080E090E0892B01\n"
    ":1002100029F00E94580281110C9400000895FC01FD\n"
    ":10022000A48DA80FB92FB11DA35ABF4F2C91848D57\n"
    ":1002300090E001968F739927848FA689B7892C93B4\n"
    ":10024000A089B1898C91837080648C93938D848D07\n"
    ":10025000981306C00288F389E02D80818F7D80830A\n"
    ":100260000895CF93DF93EC01888D8823B9F0AA8994\n"
    ":10027000BB89E889F9898C9185FD03C0808186FD61\n"
    ":100280000DC00FB607FCF7CF8C9185FFF2CF8081B0\n"
    ":1002900085FFEDCFCE010E940F01E9CFDF91CF9115\n"
    ":1002A0000895EF92FF920F931F93CF93DF93EC018A\n"
    ":1002B00081E0888F9B8D8C8D98131AC0E889F9890D\n"
    ":1002C000808185FF15C09FB7F894EE89FF89608310\n"
    ":1002D000E889F98980818370806480839FBF81E091\n"
    ":1002E00090E0DF91CF911F910F91FF90EF900895D3\n"
    ":1002F000F62E0B8D10E00F5F1F4F0F731127E02EAE\n"
    ":100300008C8D8E110CC00FB607FCFACFE889F989E5\n"
    ":10031000808185FFF5CFCE010E940F01F1CFEB8DDB\n"
    ":10032000EC0FFD2FF11DE35AFF4FF0829FB7F894B9\n"
    ":100330000B8FEA89FB8980818062CFCFCF92DF92D9\n"
    ":10034000EF92FF921F93CF93DF93EC016A017B0141\n"
    ":10035000122FE889F98982E08083C11481EED806E2\n"
    ":10036000E104F104A1F060E079E08DE390E0A70101\n"
    ":1003700096010E949B05215031094109510956956A\n"
    ":10038000479537952795211580E1380798F0E8893A\n"
    ":10039000F989108260E874E88EE190E0A701960187\n"
    ":1003A0000E949B05215031094109510956954795F5\n"
    ":1003B00037952795EC85FD853083EE85FF85208375\n"
    ":1003C000188EEC89FD891083EA89FB898081806120\n"
    ":1003D0008083EA89FB89808188608083EA89FB8940\n"
    ":1003E000808180688083EA89FB8980818F7D80831A\n"
    ":1003F000DF91CF911F91FF90EF90DF90CF90089504\n"
    ":100400001F920F920FB60F9211242F938F939F93E9\n"
    ":10041000EF93FF93E0912601F09127018081E09115\n"
    ":100420002C01F0912D0182FD1BC0908180912F0144\n"
    ":100430008F5F8F7320913001821741F0E0912F017F\n"
    ":10044000F0E0EA5EFE4F958F80932F01FF91EF91D0\n"
    ":100450009F918F912F910F900FBE0F901F90189525\n"
    ":100460008081F4CF1F920F920FB60F9211242F9319\n"
    ":100470003F934F935F936F937F938F939F93AF932C\n"
    ":10048000BF93EF93FF9386E191E00E940F01FF91EC\n"
    ":10049000EF91BF91AF919F918F917F916F915F91FC\n"
    ":1004A0004F913F912F910F900FBE0F901F90189575\n"
    ":1004B00086E191E00E94C40021E0892B09F420E04C\n"
    ":1004C000822F0895E6E1F1E01382128288EE93E034\n"
    ":1004D000A0E0B0E084839583A683B78385E091E0B4\n"
    ":1004E0009183808385EC90E09587848784EC90E00D\n"
    ":1004F0009787868780EC90E0918B808B81EC90E0F1\n"
    ":10050000938B828B82EC90E0958B848B86EC90E0D1\n"
    ":10051000978B868B118E128E138E148E0895AF9248\n"
    ":10052000BF92CF92DF92EF92FF920F931F93CF93E0\n"
    ":10053000DF936C017B018B01040F151FEB015E0142\n"
    ":10054000AE18BF08C017D10759F06991D601ED91D7\n"
    ":10055000FC910190F081E02DC6010995892B79F776\n"
    ":10056000C501DF91CF911F910F91FF90EF90DF9028\n"
    ":10057000CF90BF90AF900895FB0101900020E9F764\n"
    ":100580003197AF01461B570BDC01ED91FC910280C6\n"
    ":10059000F381E02D0994DC01ED91FC910190F08153\n"
    ":1005A000E02D099463E171E00C94BC028F929F925C\n"
    ":1005B000AF92BF92EF92FF920F931F93CF93DF936F\n"
    ":1005C000CDB7DEB7A1970FB6F894DEBF0FBECDBF93\n"
    ":1005D0007C01FA01CB0119A2223008F42AE08E0135\n"
    ":1005E0000F5D1F4F822E912CB12CA12CBF01A501B4\n"
    ":1005F00094010E949B05F901CA016A300CF5605D07\n"
    ":10060000D8016E938D01232B242B252B79F790E0B5\n"
    ":1006100080E0109721F0BD01C7010E94BC02A196A5\n"
    ":100620000FB6F894DEBF0FBECDBFDF91CF911F9103\n"
    ":100630000F91FF90EF90BF90AF909F908F90089593\n"
    ":10064000695CDECFCF92DF92EF92FF920F931F9300\n"
    ":10065000CF93DF932115310581F4DC01ED91FC91FD\n"
    ":100660000190F081E02D642FDF91CF911F910F91C8\n"
    ":10067000FF90EF90DF90CF9009942A30310501F57B\n"
    ":100680002AE077FF1DC06A017B01EC016DE20E9448\n"
    ":10069000CB028C0144275527BA014C195D096E091C\n"
    ":1006A0007F092AE0CE010E94D602800F911FDF91C0\n"
    ":1006B000CF911F910F91FF90EF90DF90CF90089511\n"
    ":1006C000DF91CF911F910F91FF90EF90DF90CF902E\n"
    ":1006D0000C94D6029A01AB01770F660B770B0C9442\n"
    ":1006E00022030F931F93CF93DF93EC010E946A03C1\n"
    ":1006F0008C01CE010E94D202800F911FDF91CF9119\n"
    ":100700001F910F9108952115310541F4DC01ED9100\n"
    ":10071000FC910190F081E02D642F09940C94D60295\n"
    ":1007200008950E9454040E9490030E948700C1E033\n"
    ":10073000D1E00E9494002097E1F30E940101F9CFDB\n"
    ":100740001F920F920FB60F9211242F933F938F9306\n"
    ":100750009F93AF93BF938091B4019091B501A09105\n"
    ":10076000B601B091B7013091B30123E0230F2D37CB\n"
    ":1007700058F50196A11DB11D2093B3018093B401DA\n"
    ":100780009093B501A093B601B093B7018091B801E1\n"
    ":100790009091B901A091BA01B091BB010196A11D40\n"
    ":1007A000B11D8093B8019093B901A093BA01B093A1\n"
    ":1007B000BB01BF91AF919F918F913F912F910F906E\n"
    ":1007C0000FBE0F901F90189526E8230F0296A11DCB\n"
    ":1007D000B11DD2CF2FB7F8946091B4017091B501DB\n"
    ":1007E0008091B6019091B7012FBF08953FB7F8945B\n"
    ":1007F0008091B8019091B901A091BA01B091BB016B\n"
    ":1008000026B5A89B05C02F3F19F00196A11DB11D6B\n"
    ":100810003FBFBA2FA92F982F8827BC01CD01620FA7\n"
    ":10082000711D811D911D42E0660F771F881F991F62\n"
    ":100830004A95D1F708958F929F92AF92BF92CF922F\n"
    ":10084000DF92EF92FF926B017C010E94F6034B0155\n"
    ":100850005C01C114D104E104F104E9F00E949A059D\n"
    ":100860000E94F603681979098A099B09683E73405A\n"
    ":100870008105910570F321E0C21AD108E108F10861\n"
    ":1008800088EE880E83E0981EA11CB11CC114D1040F\n"
    ":10089000E104F10429F7FF90EF90DF90CF90BF9033\n"
    ":1008A000AF909F908F900895789484B5826084BDB6\n"
    ":1008B00084B5816084BD85B5826085BD85B5816064\n"
    ":1008C00085BDEEE6F0E0808181608083E1E8F0E0C4\n"
    ":1008D0001082808182608083808181608083E0E8F3\n"
    ":1008E000F0E0808181608083E1EBF0E080818460D2\n"
    ":1008F0008083E0EBF0E0808181608083EAE7F0E0D4\n"
    ":100900008081846080838081826080838081816037\n"
    ":1009100080838081806880831092C10008958E302A\n"
    ":1009200008F08E502091000190E4299F900111243D\n"
    ":100930008770822B80937C0080917A008064809302\n"
    ":100940007A0080917A0086FDFCCF809178009091AA\n"
    ":10095000790008951F93CF93DF93182FEB0161E087\n"
    ":100960000E943005209739F460E0812FDF91CF910C\n"
    ":100970001F910C946C05CF3FD10511F461E0F5CFC8\n"
    ":10098000E12FF0E0E859FF4FE491E33031F140F41A\n"
    ":10099000E130B1F0E230E1F0C038D1057CF7E4CFCE\n"
    ":1009A000E73029F1E83059F1E430B1F78091800067\n"
    ":1009B000806280938000D0938B00C0938A0004C033\n"
    ":1009C00084B5806884BDC7BDDF91CF911F91089524\n"
    ":1009D00084B5806284BDC8BDF7CF809180008068F7\n"
    ":1009E00080938000D0938900C0938800EDCF8091E0\n"
    ":1009F000B00080688093B000C093B300E5CF8091D1\n"
    ":100A0000B00080628093B000C093B400DDCF83302B\n"
    ":100A100081F028F4813099F08230A9F00895873070\n"
    ":100A2000A9F08830C9F08430B1F4809180008F7DC6\n"
    ":100A300003C0809180008F7780938000089584B5F3\n"
    ":100A40008F7784BD089584B58F7DFBCF8091B000F2\n"
    ":100A50008F778093B00008958091B0008F7DF9CF9B\n"
    ":100A6000CF93DF9390E0FC01E458FF4F249180572F\n"
    ":100A70009F4FFC0184918823C9F090E0880F991F53\n"
    ":100A8000FC01E255FF4FA591B491FC01EC55FF4FDD\n"
    ":100A9000C591D49161110DC09FB7F8948C912095A8\n"
    ":100AA00082238C938881282328839FBFDF91CF9155\n"
    ":100AB0000895623051F49FB7F8943C91822F80954D\n"
    ":100AC00083238C93E8812E2BEFCF8FB7F894EC9192\n"
    ":100AD0002E2B2C938FBFEACF1F93CF93DF93282F1A\n"
    ":100AE00030E0F901E859FF4F8491F901E458FF4FD4\n"
    ":100AF000D491F901E057FF4FC491CC23A9F0162FF0\n"
    ":100B000081110E940705EC2FF0E0EE0FFF1FEC555E\n"
    ":100B1000FF4FA591B4918FB7F894EC91111108C0D3\n"
    ":100B2000D095DE23DC938FBFDF91CF911F91089585\n"
    ":100B3000DE2BF8CF0895A1E21A2EAA1BBB1BFD01E4\n"
    ":100B40000DC0AA1FBB1FEE1FFF1FA217B307E407AC\n"
    ":100B5000F50720F0A21BB30BE40BF50B661F771F04\n"
    ":100B6000881F991F1A9469F76095709580959095E4\n"
    ":100B70009B01AC01BD01CF010895EE0FFF1F059051\n"
    ":0A0B8000F491E02D0994F894FFCFE2\n"
    ":100B8A00010000000051018F02F2003101C400DEB1\n"
    ":060B9A0000D0000D0A006E\n"
    ":00000001FF\n"
    ;
const char* const kHex_arduino_Blink =
    ":100000000C945C000C946E000C946E000C946E00CA\n"
    ":100010000C946E000C946E000C946E000C946E00A8\n"
    ":100020000C946E000C946E000C946E000C946E0098\n"
    ":100030000C946E000C946E000C946E000C946E0088\n"
    ":100040000C9498000C946E000C946E000C946E004E\n"
    ":100050000C946E000C946E000C946E000C946E0068\n"
    ":100060000C946E000C946E00000000080002010069\n"
    ":100070000003040700000000000000000102040863\n"
    ":100080001020408001020408102001020408102002\n"
    ":10009000040404040404040402020202020203032E\n"
    ":1000A0000303030300000000250028002B000000CC\n"
    ":1000B0000000240027002A0011241FBECFEFD8E043\n"
    ":1000C000DEBFCDBF21E0A0E0B1E001C01D92A930AC\n"
    ":1000D000B207E1F70E9489000C940F020C94000013\n"
    ":1000E00061E08DE00C94A40161E08DE00E94E001EC\n"
    ":1000F00068EC70E080E090E00E94070160E08DE035\n"
    ":100100000E94E00168EC70E080E090E00C94070150\n"
    ":1001100008950E9440010E9488000E947000C0E083\n"
    ":10012000D0E00E9474002097E1F30E940000F9CF14\n"
    ":100130001F920F920FB60F9211242F933F938F931C\n"
    ":100140009F93AF93BF938091010190910201A09181\n"
    ":100150000301B09104013091000123E0230F2D37FA\n"
    ":1001600058F50196A11DB11D209300018093010156\n"
    ":1001700090930201A0930301B093040180910501C3\n"
    ":1001800090910601A0910701B09108010196A11D6F\n"
    ":10019000B11D8093050190930601A0930701B093D0\n"
    ":1001A0000801BF91AF919F918F913F912F910F9037\n"
    ":1001B0000FBE0F901F90189526E8230F0296A11DE1\n"
    ":1001C000B11DD2CF3FB7F8948091050190910601FF\n"
    ":1001D000A0910701B091080126B5A89B05C02F3F4B\n"
    ":1001E00019F00196A11DB11D3FBFBA2FA92F982F5D\n"
    ":1001F0008827BC01CD01620F711D811D911D42E058\n"
    ":10020000660F771F881F991F4A95D1F708958F921F\n"
    ":100210009F92AF92BF92CF92DF92EF92FF926B01CB\n"
    ":100220007C010E94E2004B015C01C114D104E10495\n"
    ":10023000F104E9F00E940E020E94E20068197909B7\n"
    ":100240008A099B09683E73408105910570F321E09E\n"
    ":10025000C21AD108E108F10888EE880E83E0981EE2\n"
    ":10026000A11CB11CC114D104E104F10429F7FF90D1\n"
    ":10027000EF90DF90CF90BF90AF909F908F900895B8\n"
    ":10028000789484B5826084BD84B5816084BD85B571\n"
    ":10029000826085BD85B5816085BDEEE6F0E0808138\n"
    ":1002A00081608083E1E8F0E0108280818260808359\n"
    ":1002B000808181608083E0E8F0E0808181608083DC\n"
    ":1002C000E1EBF0E0808184608083E0EBF0E080810E\n"
    ":1002D00081608083EAE7F0E08081846080838081B0\n"
    ":1002E0008260808380818160808380818068808358\n"
    ":1002F0001092C1000895833081F028F4813099F084\n"
    ":100300008230A9F008958730A9F08830C9F0843090\n"
    ":10031000B1F4809180008F7D03C0809180008F7741\n"
    ":1003200080938000089584B58F7784BD089584B547\n"
    ":100330008F7DFBCF8091B0008F778093B0000895C0\n"
    ":100340008091B0008F7DF9CFCF93DF9390E0FC01D7\n"
    ":10035000E458FF4F249180579F4FFC0184918823DC\n"
    ":10036000C9F090E0880F991FFC01E255FF4FA5915D\n"
    ":10037000B491FC01EC55FF4FC591D49161110DC0B2\n"
    ":100380009FB7F8948C91209582238C9388812823A1\n"
    ":1003900028839FBFDF91CF910895623051F49FB7BA\n"
    ":1003A000F8943C91822F809583238C93E8812E2BA7\n"
    ":1003B000EFCF8FB7F894EC912E2B2C938FBFEACF11\n"
    ":1003C0001F93CF93DF93282F30E0F901E859FF4FB7\n"
    ":1003D0008491F901E458FF4FD491F901E057FF4FA0\n"
    ":1003E000C491CC23A9F0162F81110E947B01EC2F20\n"
    ":1003F000F0E0EE0FFF1FEC55FF4FA591B4918FB7C2\n"
    ":10040000F894EC91111108C0D095DE23DC938FBFD6\n"
    ":10041000DF91CF911F910895DE2BF8CF0895F894C6\n"
    ":02042000FFCF0C\n"
    ":00000001FF\n"
    ;
const char* const kHex_blink =
    ":100000000C9434000C943E000C943E000C943E0082\n"
    ":100010000C943E000C943E000C943E000C943E0068\n"
    ":100020000C943E000C943E000C943E000C943E0058\n"
    ":100030000C943E000C943E000C943E000C943E0048\n"
    ":100040000C943E000C943E000C943E000C943E0038\n"
    ":100050000C943E000C943E000C943E000C943E0028\n"
    ":100060000C943E000C943E0011241FBECFEFD8E04C\n"
    ":10007000DEBFCDBF0E9440000C944F000C940000E6\n"
    ":10008000259A90E285B1892785B92FEF34E38CE07A\n"
    ":10009000215030408040E1F700C00000F3CFF894D9\n"
    ":0200A000FFCF90\n"
    ":00000001FF\n"
    ;
const char* const kHex_button =
    ":100000000C9434000C945A000C9451000C94510040\n"
    ":100010000C9451000C9451000C9451000C9451001C\n"
    ":100020000C9451000C9451000C9451000C9451000C\n"
    ":100030000C9451000C9451000C9451000C945100FC\n"
    ":100040000C9451000C9451000C9451000C945100EC\n"
    ":100050000C9451000C9451000C9451000C945100DC\n"
    ":100060000C9451000C94510011241FBECFEFD8E026\n"
    ":10007000DEBFCDBF11E0A0E0B1E0E8EEF1E002C0EC\n"
    ":1000800005900D92A830B107D9F721E0A8E0B1E0C2\n"
    ":1000900001C01D92AA30B207E1F70E946E000C94D5\n"
    ":1000A000F2000C9400009091C00095FFFCCF80936B\n"
    ":1000B000C60008951F920F920FB60F9211248F93CE\n"
    ":1000C000809109018F5F8093090181E0809308018D\n"
    ":1000D0008F910F900FBE0F901F901895CF93DF93C5\n"
    ":1000E000CDB7DEB72B970FB6F894DEBF0FBECDBFEE\n"
    ":1000F0001092C50088E08093C4001092C0008093E5\n"
    ":10010000C10086E08093C200259A5A9A82E08093CB\n"
    ":10011000690081E08DBB7894CE0101967C018AE074\n"
    ":10012000882E912CA12CB12C4A9B35C02D98809102\n"
    ":1001300008018823C9F31092080100E011E0F801DA\n"
    ":1001400081918F01811129C06091090170E090E0D7\n"
    ":1001500080E0670110E000E00F5F1F4FA5019401F0\n"
    ":100160000E94D000605DF60161936F01B901CA0180\n"
    ":10017000611571058105910579F70E0D1F1DF801B7\n"
    ":1001800082918F010E9453000E151F05C1F78AE06E\n"
    ":100190000E945300C9CF2D9ACACF0E945300CFCFDF\n"
    ":1001A000A1E21A2EAA1BBB1BFD010DC0AA1FBB1F7B\n"
    ":1001B000EE1FFF1FA217B307E407F50720F0A21BED\n"
    ":1001C000B30BE40BF50B661F771F881F991F1A945A\n"
    ":1001D00069F760957095809590959B01AC01BD0184\n"
    ":0801E000CF010895F894FFCF50\n"
    ":0801E8007072657373200000C2\n"
    ":00000001FF\n"
    ;
const char* const kHex_hello =
    ":100000000C9434000C9449000C9449000C94490061\n"
    ":100010000C9449000C9449000C9449000C9449003C\n"
    ":100020000C9449000C9449000C9449000C9449002C\n"
    ":100030000C9449000C9449000C9449000C9449001C\n"
    ":100040000C9449000C9449000C9449000C9449000C\n"
    ":100050000C9449000C9449000C9449000C944900FC\n"
    ":100060000C9449000C94490011241FBECFEFD8E036\n"
    ":10007000DEBFCDBF11E0A0E0B1E0E2EBF1E002C0F5\n"
    ":1000800005900D92A431B107D9F70E9457000C9446\n"
    ":10009000D7000C940000FC019191911101C00895CA\n"
    ":1000A0008091C00085FFFCCF9093C600F5CFCF9321\n"
    ":1000B000DF93CDB7DEB72B970FB6F894DEBF0FBE38\n"
    ":1000C000CDBF1092C50087E68093C4001092C00097\n"
    ":1000D00088E08093C10086E08093C20080E091E0D8\n"
    ":1000E0000E944B00F12CE12CCE0101966C018AE0BC\n"
    ":1000F000482E512C612C712C80E191E00E944B0024\n"
    ":10010000B70190E080E0560110E000E00F5F1F4F64\n"
    ":10011000A30192010E94B500605DF50161935F014A\n"
    ":10012000B901CA01611571058105910579F7F601DB\n"
    ":10013000E00FF11F82919091C00095FFFCCF80935A\n"
    ":10014000C600CE16DF06B1F78DE091E00E944B00AD\n"
    ":10015000FFEF29EF80E0F15020408040E1F700C040\n"
    ":1001600000009FEFE91AF90AC7CFA1E21A2EAA1BD5\n"
    ":10017000BB1BFD010DC0AA1FBB1FEE1FFF1FA21757\n"
    ":10018000B307E407F50720F0A21BB30BE40BF50B54\n"
    ":10019000661F771F881F991F1A9469F760957095DD\n"
    ":1001A000809590959B01AC01BD01CF010895F89415\n"
    ":0201B000FFCF7F\n"
    ":1001B20048656C6C6F2C205369454441210D0A003F\n"
    ":0401C2006E3D00008E\n"
    ":00000001FF\n"
    ;
const char* const kHex_timer_isr =
    ":100000000C9434000C9446000C9446000C9446006A\n"
    ":100010000C9446000C9446000C9446000C94460048\n"
    ":100020000C9446000C9446000C9446000C94480036\n"
    ":100030000C9446000C9446000C9446000C94460028\n"
    ":100040000C9446000C9446000C9446000C94460018\n"
    ":100050000C9446000C9446000C9446000C94460008\n"
    ":100060000C9446000C94460011241FBECFEFD8E03C\n"
    ":10007000DEBFCDBF21E0A0E0B1E001C01D92A23003\n"
    ":10008000B207E1F70E945F000C94F1000C940000AD\n"
    ":100090001F920F920FB60F9211248F939F9380910E\n"
    ":1000A000000190910101019690930101809300015C\n"
    ":1000B0009F918F910F900FBE0F901F901895CF9327\n"
    ":1000C000DF93CDB7DEB72B970FB6F894DEBF0FBE28\n"
    ":1000D000CDBF1092C50088E08093C4001092C0008C\n"
    ":1000E0008093C10086E08093C200259A1092800020\n"
    ":1000F0008BE08093810089EF90E09093890080935A\n"
    ":10010000880082E080936F007894F12CE12C80E2EB\n"
    ":10011000882ECE0101966C019AE0492E512C612C5B\n"
    ":10012000712C2AE0922EF8948091000190910101A7\n"
    ":1001300078948E199F0984369105A8F394E6E90E08\n"
    ":10014000F11C85B1882585B9B70190E080E05601A2\n"
    ":1001500010E000E00F5F1F4FA30192010E94CF004B\n"
    ":10016000605DF50161935F01B901CA016115710517\n"
    ":100170008105910579F7F601E00FF11F82919091C9\n"
    ":10018000C00095FFFCCF8093C600CE16DF06B1F706\n"
    ":100190008091C00085FFFCCF9092C600C4CFA1E241\n"
    ":1001A0001A2EAA1BBB1BFD010DC0AA1FBB1FEE1FF1\n"
    ":1001B000FF1FA217B307E407F50720F0A21BB30B3C\n"
    ":1001C000E40BF50B661F771F881F991F1A9469F7B8\n"
    ":1001D00060957095809590959B01AC01BD01CF0114\n"
    ":0601E0000895F894FFCF22\n"
    ":00000001FF\n"
    ;
const char* const kHex_tiny_blink =
    ":100000000EC015C014C013C012C011C010C00FC064\n"
    ":100010000EC00DC00CC00BC00AC009C008C011241E\n"
    ":100020001FBECFE5D2E0DEBFCDBF02D018C0E8CF03\n"
    ":1000300087B3836087BB83E28ABD81E083BF80E8AA\n"
    ":1000400088BD91E088B3892788BB2FEF30E782E035\n"
    ":10005000215030408040E1F700C00000F3CFF89419\n"
    ":02006000FFCFD0\n"
    ":00000001FF\n"
    ;
